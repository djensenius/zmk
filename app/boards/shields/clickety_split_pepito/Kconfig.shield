## app/boards/shields/clickety_split_pepito/Kconfig.shield
```kconfig
# Copyright (c) 2023 The ZMK Contributors
# SPDX-License-Identifier: MIT

config SHIELD_CLICKETY_SPLIT_PEPITO
    bool

config SHIELD_CLICKETY_SPLIT_PEPITO_LEFT
    def_bool $(shields_list_contains,clickety_split_pepito_left)
    select SHIELD_CLICKETY_SPLIT_PEPITO

config SHIELD_CLICKETY_SPLIT_PEPITO_RIGHT
    def_bool $(shields_list_contains,clickety_split_pepito_right)
    select SHIELD_CLICKETY_SPLIT_PEPITO
```

## app/boards/shields/clickety_split_pepito_macro/Kconfig.shield
```kconfig
# Copyright (c) 2023 The ZMK Contributors
# SPDX-License-Identifier: MIT

config SHIELD_CLICKETY_SPLIT_PEPITO_MACRO
    def_bool $(shields_list_contains,clickety_split_pepito_macro)
```
